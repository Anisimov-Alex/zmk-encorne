## boards/shields/zmk-encorne/Kconfig.defconfig
```kconfig
if SHIELD_ENCORNE_LEFT

config ZMK_KEYBOARD_NAME
    default "ENCORNE1"

config ZMK_SPLIT_ROLE_CENTRAL
    default y

endif

if SHIELD_ENCORNE_LEFT || SHIELD_ENCORNE_RIGHT

config ZMK_SPLIT
    default y

endif
```

## boards/shields/zmk-encorne/Kconfig.shield
```kconfig
config SHIELD_ENCORNE_LEFT
    def_bool $(shields_list_contains,encorne_left)

config SHIELD_ENCORNE_RIGHT
    def_bool $(shields_list_contains,encorne_right)
```
